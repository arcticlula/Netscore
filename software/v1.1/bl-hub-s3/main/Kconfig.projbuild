## software/v1.1/bl-hub-s3/main/Kconfig.projbuild
```kconfig
menu "ESP HID Host Configuration"

    config LOG_BUTTON_EVENTS_ONLY
        bool "Log button events only (suppress hex dumps)"
        default n
        help
            When enabled, suppresses verbose hex dumps during GATT notifications
            to reduce log noise. Only button event logs will be shown.

endmenu
```

## software/v2.0 Prototype/main-unit/sdkconfig.defaults
```kconfig
CONFIG_BT_ENABLED=y
CONFIG_BTDM_CTRL_MODE_BTDM=y
CONFIG_BT_BLUEDROID_ENABLED=y
CONFIG_BT_CLASSIC_ENABLED=y
CONFIG_BT_BLE_ENABLED=y
CONFIG_BT_HID_ENABLED=y
CONFIG_BT_HID_HOST_ENABLED=y
CONFIG_BT_BLE_42_FEATURES_SUPPORTED=y
CONFIG_BT_GATTC_NOTIF_REG_MAX=16
CONFIG_BT_GATTS_ENABLE=y
CONFIG_BT_GATTC_ENABLE=y
CONFIG_BT_SMP_ENABLE=y
# Increase app partition to 2MB
CONFIG_PARTITION_TABLE_CUSTOM=y
CONFIG_PARTITION_TABLE_CUSTOM_FILENAME="partitions.csv"
CONFIG_PARTITION_TABLE_FILENAME="partitions.csv"
# Enable 4MB Flash
CONFIG_ESPTOOLPY_FLASHSIZE_4MB=y
CONFIG_ESPTOOLPY_FLASHSIZE="4MB"
```
