## software/main-unit/main/Kconfig.projbuild
```kconfig
menu "Netscore board revision"

choice NETSCORE_BOARD
    prompt "Main board hardware revision"
    default NETSCORE_BOARD_V20
    help
        Selects the hardware revision this firmware targets. Pins and the
        buzzer/nav-input drivers are chosen accordingly (see main/boards).

    config NETSCORE_BOARD_V20
        bool "v2.0 (DRV8833 buzzer, 3 nav buttons, 2x12 slot header)"

    config NETSCORE_BOARD_V30
        bool "v3.0 (DRV8662 buzzer, rotary encoder, 30-pin FPC slots)"
endchoice

endmenu
```
